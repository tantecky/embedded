## nrf52840/bt_thermocouple/boards/arm/ms88sf2/Kconfig
```kconfig
if BOARD_MS88SF2

config BOARD_ENABLE_DCDC
	bool "Enable DCDC mode"
	select SOC_DCDC_NRF52X
	default y

config BOARD_HAS_NRF5_BOOTLOADER
	bool "Board has nRF5 bootloader"
	default n
endif # BOARD_MS88SF2
```

## nrf52840/bt_thermocouple/boards/arm/ms88sf2/Kconfig.board
```kconfig
# Copyright (c) 2021 Nordic Semiconductor ASA
# SPDX-License-Identifier: Apache-2.0

config BOARD_MS88SF2
	bool "MS88SF2"
	depends on SOC_NRF52840_QIAA
```

## nrf52840/bt_thermocouple/boards/arm/ms88sf2/Kconfig.defconfig
```kconfig
# Copyright (c) 2021 Nordic Semiconductor ASA
# SPDX-License-Identifier: Apache-2.0

if BOARD_MS88SF2

config BOARD
	default "ms88sf2"

config BT_CTLR
   default BT

endif
```
