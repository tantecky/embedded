## CMakeLists.txt
```
# SPDX-License-Identifier: Apache-2.0

cmake_minimum_required(VERSION 3.13.1)
set_property(GLOBAL PROPERTY CSTD gnu99)

find_package(Zephyr REQUIRED HINTS $ENV{ZEPHYR_BASE})
project(peripheral_ht)

FILE(GLOB app_sources src/Arduino.c src/MAX31856.cpp src/maxik.cpp src/thermo.c src/main.c)
target_sources(app PRIVATE
  ${app_sources}
  )
```

## sample.yaml
```
sample:
  description: TBD
  name: TBD
tests:
  sample.bluetooth.peripheral_ht:
    harness: bluetooth
    platform_allow: qemu_cortex_m3 qemu_x86
    tags: bluetooth
  sample.bluetooth.peripheral_ht.frdm_kw41z_shield:
    harness: bluetooth
    platform_allow: mimxrt1020_evk mimxrt1050_evk mimxrt1060_evk frdm_k64f
    tags: bluetooth
    extra_args: SHIELD=frdm_kw41z
```

## prj.conf
```kconfig
CONFIG_BT=y
# https://docs.zephyrproject.org/1.12.0/reference/kconfig/CONFIG_BT_DEBUG_LOG.html
CONFIG_BT_DEBUG_LOG=y
CONFIG_BT_SMP=n
CONFIG_BT_PERIPHERAL=y
CONFIG_BT_DIS=n
CONFIG_BT_DIS_PNP=n
CONFIG_BT_DEVICE_NAME="PanTeplota"
# https://specificationrefs.bluetooth.com/assigned-values/Appearance%20Values.pdf
CONFIG_BT_DEVICE_APPEARANCE=768
CONFIG_BT_ATT_ENFORCE_FLOW=n
CONFIG_CBPRINTF_FP_SUPPORT=y

CONFIG_GPIO=y

CONFIG_BOARD_HAS_NRF5_BOOTLOADER=n

CONFIG_PRINTK=y
CONFIG_CONSOLE=y
CONFIG_UART_CONSOLE=n
CONFIG_RTT_CONSOLE=y
CONFIG_USE_SEGGER_RTT=y

CONFIG_CPLUSPLUS=y
CONFIG_STD_CPP14=y

CONFIG_FPU=y
```

## boards/nrf52dk_nrf52832.conf
```kconfig
CONFIG_SENSOR=y
CONFIG_TEMP_NRF5=y
```

## src/main.c
```c
/* main.c - Application main entry point */

/*
 * Copyright (c) 2019 Aaron Tsui <aaron.tsui@outlook.com>
 *
 * SPDX-License-Identifier: Apache-2.0
 */

#include <zephyr/types.h>
#include <stddef.h>
#include <string.h>
#include <errno.h>
#include <sys/printk.h>
#include <sys/byteorder.h>
#include <zephyr.h>

#include <bluetooth/bluetooth.h>
#include <bluetooth/hci.h>
#include <bluetooth/conn.h>
#include <bluetooth/uuid.h>
#include <bluetooth/gatt.h>

#include "Arduino.h"
#include "thermo.h"
#include "maxik.h"

#define LED_GREEN (6)
#define LED_RED (8)
#define LED_BLUE (12)

struct bt_conn *default_conn;

static const struct bt_data ad[] = {
	BT_DATA_BYTES(BT_DATA_FLAGS, (BT_LE_AD_GENERAL | BT_LE_AD_NO_BREDR)),
	BT_DATA_BYTES(BT_DATA_UUID16_ALL,
				  BT_UUID_16_ENCODE(BT_UUID_TEMPERATURE_VAL)),
};

static void connected(struct bt_conn *conn, uint8_t err)
{
	if (err)
	{
		printk("Connection failed (err 0x%02x)\n", err);
	}
	else
	{
		default_conn = bt_conn_ref(conn);
		printk("Connected\n");

		digitalWrite(LED_GREEN, HIGH);
	}
}

static void disconnected(struct bt_conn *conn, uint8_t reason)
{
	printk("Disconnected (reason 0x%02x)\n", reason);

	if (default_conn)
	{
		bt_conn_unref(default_conn);
		default_conn = NULL;
	}

	digitalWrite(LED_GREEN, LOW);
}

static struct bt_conn_cb conn_callbacks = {
	.connected = connected,
	.disconnected = disconnected,
};

static void bt_ready(void)
{
	int err;

	printk("Bluetooth initialized\n");

	err = bt_le_adv_start(BT_LE_ADV_CONN_NAME, ad, ARRAY_SIZE(ad), NULL, 0);
	if (err)
	{
		printk("Advertising failed to start (err %d)\n", err);
		return;
	}

	printk("Advertising successfully started\n");
}

static void bt_init(void)
{

	int err;

	err = bt_enable(NULL);
	if (err)
	{
		printk("Bluetooth init failed (err %d)\n", err);
		return;
	}

	bt_ready();

	bt_conn_cb_register(&conn_callbacks);
}

void main(void)
{

	pinMode(LED_BLUE, OUTPUT);
	pinMode(LED_GREEN, OUTPUT);

	digitalWrite(LED_BLUE, HIGH);
	digitalWrite(LED_GREEN, LOW);

	maxik_init();
	bt_init();

	// while (1)
	// {
	// 	update_temperature();
	// }

	while (1)
	{

		if (default_conn)
		{
			if (!check_temperature())
			{
				k_sleep(K_SECONDS(1));
			}
		}
		else
		{

			k_sleep(K_SECONDS(1));
		}
	}
}
```

## src/Arduino.c
```c
#include <zephyr.h>
#include <drivers/gpio.h>
#include <sys/printk.h>

#include "Arduino.h"

static struct device *port0 = NULL;

void pinMode(uint8_t pin, uint32_t mode)
{
    if (!port0)
    {
        port0 = (struct device *)device_get_binding("GPIO_0");
    }

    if (!port0)
    {
        printk("device_get_binding failed");
        return;
    }

    int err = gpio_pin_configure(port0, pin,
                                 mode);

    if (err)
    {
        printk("gpio_pin_configure failed %d\n", err);
        return;
    }
}

void digitalWrite(uint8_t pin, uint32_t val)
{
    int err = gpio_pin_set_raw(port0, pin, val);

    if (err)
    {
        printk("gpio_pin_set_raw failed %d\n", err);
        return;
    }
}

int digitalRead(uint8_t pin)
{
    return 0;
}
```

## src/Arduino.h
```c
#ifndef DA2E9751_365B_4134_8D8F_A48EA6856F43
#define DA2E9751_365B_4134_8D8F_A48EA6856F43

#include <stdint.h>
#include <zephyr.h>
#include <drivers/gpio.h>

typedef uint8_t byte;

#define LOW (0x0)
#define HIGH (0x1)
#define INPUT (GPIO_INPUT)
#define OUTPUT (GPIO_OUTPUT)
#define INPUT_PULLUP (GPIO_INPUT | GPIO_PULL_UP)

#define delayMicroseconds(x) NRFX_DELAY_US((x))

void pinMode(uint8_t pin, uint32_t mode);
void digitalWrite(uint8_t pin, uint32_t val);
int digitalRead(uint8_t pin);

#endif /* DA2E9751_365B_4134_8D8F_A48EA6856F43 */
```

## src/MAX31856.cpp
```c
// This is a library for the Maxim MAX31856 thermocouple IC
// http://datasheets.maximintegrated.com/en/ds/MAX31856.pdf
//
// Written by Peter Easton (www.whizoo.com)
// Released under CC BY-SA 3.0 license
//
// Look for the MAX31856 breakout boards on www.whizoo.com and eBay (madeatrade)
// http://stores.ebay.com/madeatrade
//
// Looking to build yourself a reflow oven?  It isn't that difficult to
// do!  Take a look at the build guide here:
// http://www.whizoo.com
//
// Library Implementation Details
// ==============================
// DRDY and FAULT lines are not used in this driver. DRDY is useful for low-power mode so samples are only taken when
// needed; this driver assumes power isn't an issue.  The FAULT line can be used to generate an interrupt in the host
// processor when a fault occurs.  This library reads the fault register every time a reading is taken, and will
// return a fault error if there is one.  The MAX31856 has sophisticated usage scenarios involving FAULT.  For
// example, low and high temperature limits can be set, and the FAULT line triggers when these temperatures are
// breached. This is beyond the scope of this sample library.  The assumption is that most applications will be
// polling for temperature readings - but it is good to know these features are supported by the hardware.
//
// The MAX31856 differs from earlier thermocouple IC's in that it has registers that must be configured before
// readings can be taken.  This makes it very flexible and powerful, but one concern is power loss to the IC.  The IC
// should be as close to the cold junction as possible, which might mean there is a cable connecting the breakout
// board to the host processor.  If this cable is disconnected and reconnected (MAX31856 loses power) then the
// registers must be reinitialized.  This library detects this condition and will automatically reconfigure the
// registers.  This simplifies the software running on the host.
//
// A lot of configuration options appear in the .H file.  Of particular note is the line frequency filtering, which
// defaults to 60Hz (USA and others).  If your line voltage is 50Hz you should set CR0_NOISE_FILTER_50HZ.
//
// This library handles the full range of temperatures, including negative temperatures.
//
//
// Change History:
// 25 June 2015        Initial Version
// 31 July 2015        Fixed spelling and formatting problems

#include "MAX31856.h"

// Define which pins are connected to the MAX31856.  The DRDY and FAULT outputs
// from the MAX31856 are not used in this library.
MAX31856::MAX31856(int sdi, int sdo, int cs, int clk)
{
    MAX31856::init(sdi, sdo, cs, clk);
}

// Define which pins are connected to the MAX31856.  The DRDY and FAULT outputs
// from the MAX31856 are not used in this library.
void MAX31856::init(int sdi, int sdo, int cs, int clk)
{
    _sdi = sdi;
    _sdo = sdo;
    _cs = cs;
    _clk = clk;

    // Initialize all the data pins
    pinMode(_sdi, OUTPUT);
    pinMode(_cs, OUTPUT);
    pinMode(_clk, OUTPUT);
    // Use a pullup on the data line to be able to detect "no communication"
    pinMode(_sdo, INPUT_PULLUP);

    // Default output pins state
    digitalWrite(_cs, HIGH);
    digitalWrite(_clk, HIGH);

    // Set up the shadow registers with the default values
    byte reg[NUM_REGISTERS] = {0x00, 0x03, 0xff, 0x7f, 0xc0, 0x7f, 0xff, 0x80, 0, 0, 0, 0};
    for (int i = 0; i < NUM_REGISTERS; i++)
        _registers[i] = reg[i];
}

// Write the given data to the MAX31856 register
void MAX31856::writeRegister(byte registerNum, byte data)
{
    // Sanity check on the register number
    if (registerNum >= NUM_REGISTERS)
        return;

    // Select the MAX31856 chip
    digitalWrite(_cs, LOW);

    // Write the register number, with the MSB set to indicate a write
    writeByte(WRITE_OPERATION(registerNum));

    // Write the register value
    writeByte(data);

    // Deselect MAX31856 chip
    digitalWrite(_cs, HIGH);

    // Save the register value, in case the registers need to be restored
    _registers[registerNum] = data;
}

// Read the thermocouple temperature either in Degree Celsius or Fahrenheit. Internally,
// the conversion takes place in the background within 155 ms, or longer depending on the
// number of samples in each reading (see CR1).
// Returns the temperature, or an error (FAULT_OPEN, FAULT_VOLTAGE or NO_MAX31856)
float MAX31856::readThermocouple(byte unit)
{
    float temperature;
    long data;

    // Select the MAX31856 chip
    digitalWrite(_cs, LOW);

    // Read data starting with register 0x0c
    writeByte(READ_OPERATION(0x0c));

    // Read 4 registers
    data = readData();

    // Deselect MAX31856 chip
    digitalWrite(_cs, HIGH);

    // If there is no communication from the IC then data will be all 1's because
    // of the internal pullup on the data line (INPUT_PULLUP)
    if (data == -1)
        return NO_MAX31856;

    // If the value is zero then the temperature could be exactly 0.000 (rare), or
    // the IC's registers are uninitialized.
    if (data == 0 && verifyMAX31856() == NO_MAX31856)
        return NO_MAX31856;

    // Was there an error?
    if (data & SR_FAULT_OPEN)
        temperature = FAULT_OPEN;
    else if (data & SR_FAULT_UNDER_OVER_VOLTAGE)
        temperature = FAULT_VOLTAGE;
    else
    {
        // Strip the unused bits and the Fault Status Register
        data = data >> 13;

        // Negative temperatures have been automagically handled by the shift above :-)

        // Convert to Celsius
        temperature = (float)data * 0.0078125f;

        // Convert to Fahrenheit if desired
        if (unit == FAHRENHEIT)
            temperature = (temperature * 9.0f / 5.0f) + 32;
    }

    // Return the temperature
    return (temperature);
}

// Read the junction (IC) temperature either in Degree Celsius or Fahrenheit.
// This routine also makes sure that communication with the MAX31856 is working and
// will return NO_MAX31856 if not.
float MAX31856::readJunction(byte unit)
{
    float temperature;
    long data, temperatureOffset;

    // Select the MAX31856 chip
    digitalWrite(_cs, LOW);

    // Read data starting with register 8
    writeByte(READ_OPERATION(8));

    // Read 4 registers
    data = readData();

    // Deselect MAX31856 chip
    digitalWrite(_cs, HIGH);

    // If there is no communication from the IC then data will be all 1's because
    // of the internal pullup on the data line (INPUT_PULLUP)
    if (data == -1)
        return NO_MAX31856;

    // If the value is zero then the temperature could be exactly 0.000 (rare), or
    // the IC's registers are uninitialized.
    if (data == 0 && verifyMAX31856() == NO_MAX31856)
        return NO_MAX31856;

    // Register 9 is the temperature offset
    temperatureOffset = (data & 0x00FF0000) >> 16;

    // Is this a negative number?
    if (temperatureOffset & 0x80)
        temperatureOffset |= 0xFFFFFF00;

    // Strip registers 8 and 9, taking care of negative numbers
    if (data & 0x8000)
        data |= 0xFFFF0000;
    else
        data &= 0x0000FFFF;

    // Remove the 2 LSB's - they aren't used
    data = data >> 2;

    // Add the temperature offset to the temperature
    temperature = data + temperatureOffset;

    // Convert to Celsius
    temperature *= 0.015625f;

    // Convert to Fahrenheit if desired
    if (unit == FAHRENHEIT)
        temperature = (temperature * 9.0f / 5.0f) + 32;

    // Return the temperature
    return (temperature);
}

// When the MAX31856 is uninitialzed and either the junction or thermocouple temperature is read it will return 0.
// This is a valid temperature, but could indicate that the registers need to be initialized.
float MAX31856::verifyMAX31856()
{
    long data, reg;

    // Select the MAX31856 chip
    digitalWrite(_cs, LOW);

    // Read data starting with register 0
    writeByte(READ_OPERATION(0));

    // Read 4 registers
    data = readData();

    // Deselect MAX31856 chip
    digitalWrite(_cs, HIGH);

    // If there is no communication from the IC then data will be all 1's because
    // of the internal pullup on the data line (INPUT_PULLUP)
    if (data == -1)
        return NO_MAX31856;

    // Are the registers set to their correct values?
    reg = ((long)_registers[0] << 24) + ((long)_registers[1] << 16) + ((long)_registers[2] << 8) + _registers[3];
    if (reg == data)
        return 0;

    // Communication to the IC is working, but the register values are not correct
    // Select the MAX31856 chip
    digitalWrite(_cs, LOW);

    // Start writing from register 0
    writeByte(WRITE_OPERATION(0));

    // Write the register values
    for (int i = 0; i < NUM_REGISTERS; i++)
        writeByte(_registers[i]);

    // Deselect MAX31856 chip
    digitalWrite(_cs, HIGH);

    // For now, return an error but soon valid temperatures will be returned
    return NO_MAX31856;
}

// Read in 32 bits of data from MAX31856 chip. Minimum clock pulse width is 100 ns
// so this could be made faster (using NOP).  However, make sure it works on all
// microcontrollers
long MAX31856::readData()
{
    long data = 0;
    unsigned long bitMask = 0x80000000;

    // Shift in 32 bits of data
    while (bitMask)
    {
        digitalWrite(_clk, LOW);
        delayMicroseconds(2);

        // Store the data bit
        if (digitalRead(_sdo))
            data += bitMask;

        digitalWrite(_clk, HIGH);
        delayMicroseconds(2);

        bitMask >>= 1;
    }

    return (data);
}

// Write out 8 bits of data to the MAX31856 chip. Minimum clock pulse width is 100 ns
// so this could be made faster (using NOP).  However, make sure it works on all
// microcontrollers
void MAX31856::writeByte(byte data)
{
    byte bitMask = 0x80;

    // Shift out 8 bits of data
    while (bitMask)
    {
        // Write out the data bit.  Has to be held for 35ns
        digitalWrite(_sdi, data & bitMask ? HIGH : LOW);

        digitalWrite(_clk, LOW);
        delayMicroseconds(2);
        digitalWrite(_clk, HIGH);
        delayMicroseconds(2);

        bitMask >>= 1;
    }
}
```

## src/MAX31856.h
```c
// This is a library for the Maxim MAX31856 thermocouple IC
// http://datasheets.maximintegrated.com/en/ds/MAX31856.pdf
//
// Written by Peter Easton (www.whizoo.com)
// Released under CC BY-SA 3.0 license
//
// Look for the MAX31856 breakout boards on www.whizoo.com and eBay (madeatrade)
// http://stores.ebay.com/madeatrade
//
// Looking to build yourself a reflow oven?  It isn't that difficult to
// do!  Take a look at the build guide here:
// http://www.whizoo.com
//
// Change History:
// 25 June 2015        Initial Version
// 31 July 2015        Fixed spelling and formatting problems

#ifndef MAX31856_H
#define MAX31856_H

#include "Arduino.h"

// MAX31856 Registers
// Register 0x00: CR0
#define CR0_AUTOMATIC_CONVERSION 0x80
#define CR0_ONE_SHOT 0x40
#define CR0_OPEN_CIRCUIT_FAULT_TYPE_K 0x10 // Type-K is 10 to 20 Ohms
#define CR0_COLD_JUNCTION_DISABLED 0x08
#define CR0_FAULT_INTERRUPT_MODE 0x04
#define CR0_FAULT_CLEAR 0x02
#define CR0_NOISE_FILTER_50HZ 0x01
// Register 0x01: CR1
#define CR1_AVERAGE_1_SAMPLES 0x00
#define CR1_AVERAGE_2_SAMPLES 0x10
#define CR1_AVERAGE_4_SAMPLES 0x20
#define CR1_AVERAGE_8_SAMPLES 0x30
#define CR1_AVERAGE_16_SAMPLES 0x40
#define CR1_THERMOCOUPLE_TYPE_B 0x00
#define CR1_THERMOCOUPLE_TYPE_E 0x01
#define CR1_THERMOCOUPLE_TYPE_J 0x02
#define CR1_THERMOCOUPLE_TYPE_K 0x03
#define CR1_THERMOCOUPLE_TYPE_N 0x04
#define CR1_THERMOCOUPLE_TYPE_R 0x05
#define CR1_THERMOCOUPLE_TYPE_S 0x06
#define CR1_THERMOCOUPLE_TYPE_T 0x07
#define CR1_VOLTAGE_MODE_GAIN_8 0x08
#define CR1_VOLTAGE_MODE_GAIN_32 0x0C
// Register 0x02: MASK
#define MASK_COLD_JUNCTION_HIGH_FAULT 0x20
#define MASK_COLD_JUNCTION_LOW_FAULT 0x10
#define MASK_THERMOCOUPLE_HIGH_FAULT 0x08
#define MASK_THERMOCOUPLE_LOW_FAULT 0x04
#define MASK_VOLTAGE_UNDER_OVER_FAULT 0x02
#define MASK_THERMOCOUPLE_OPEN_FAULT 0x01
// Register 0x0F: SR
#define SR_FAULT_COLD_JUNCTION_OUT_OF_RANGE 0x80
#define SR_FAULT_THERMOCOUPLE_OUT_OF_RANGE 0x40
#define SR_FAULT_COLD_JUNCTION_HIGH 0x20
#define SR_FAULT_COLD_JUNCTION_LOW 0x10
#define SR_FAULT_THERMOCOUPLE_HIGH 0x08
#define SR_FAULT_THERMOCOUPLE_LOW 0x04
#define SR_FAULT_UNDER_OVER_VOLTAGE 0x02
#define SR_FAULT_OPEN 0x01

// Set/clear MSB of first byte sent to indicate write or read
#define READ_OPERATION(x) (x & 0x7F)
#define WRITE_OPERATION(x) (x | 0x80)

// Register numbers
#define REGISTER_CR0 0
#define REGISTER_CR1 1
#define REGISTER_MASK 2
#define NUM_REGISTERS 12 // (read/write registers)

// Errors
#define FAULT_OPEN 10000    // No thermocouple
#define FAULT_VOLTAGE 10001 // Under/over voltage error.  Wrong thermocouple type?
#define NO_MAX31856 10002   // MAX31856 not communicating or not connected
#define IS_MAX31856_ERROR(x) (x == FAULT_OPEN && x <= NO_MAX31856)

#define CELSIUS 0
#define FAHRENHEIT 1

class MAX31856
{
public:
    MAX31856(int, int, int, int); // SDI, SDO, CS, CLK (DRDY and FAULT are not used)

    void writeRegister(byte, byte);
    float readThermocouple(byte unit);
    float readJunction(byte unit);

private:
    long readData();
    void writeByte(byte);
    float verifyMAX31856();
    int _sdi, _sdo, _cs, _clk;
    byte _registers[NUM_REGISTERS]; // Shadow registers.  Registers can be restored if power to MAX31855 is lost
};

#endif // MAX31856_H
```

## src/hts.c
```c
/** @file
 *  @brief HTS Service sample
 */

/*
 * Copyright (c) 2020 SixOctets Systems
 * Copyright (c) 2019 Aaron Tsui <aaron.tsui@outlook.com>
 *
 * SPDX-License-Identifier: Apache-2.0
 */

#include <stdio.h>
#include <stddef.h>
#include <string.h>
#include <errno.h>

#include <zephyr.h>
#include <drivers/sensor.h>
#include <sys/printk.h>
#include <sys/byteorder.h>

#include <bluetooth/bluetooth.h>
#include <bluetooth/hci.h>
#include <bluetooth/conn.h>
#include <bluetooth/uuid.h>
#include <bluetooth/gatt.h>

static const struct device *temp_dev;

static uint8_t simulate_htm;
static uint8_t indicating;
static struct bt_gatt_indicate_params ind_params;

static void htmc_ccc_cfg_changed(const struct bt_gatt_attr *attr,
				 uint16_t value)
{
	simulate_htm = (value == BT_GATT_CCC_INDICATE) ? 1 : 0;
}

static void indicate_cb(struct bt_conn *conn,
			struct bt_gatt_indicate_params *params, uint8_t err)
{
	printk("Indication %s\n", err != 0U ? "fail" : "success");
}

static void indicate_destroy(struct bt_gatt_indicate_params *params)
{
	printk("Indication complete\n");
	indicating = 0U;
}

/* Heart Rate Service Declaration */
BT_GATT_SERVICE_DEFINE(hts_svc,
	BT_GATT_PRIMARY_SERVICE(BT_UUID_HTS),
	BT_GATT_CHARACTERISTIC(BT_UUID_HTS_MEASUREMENT, BT_GATT_CHRC_INDICATE,
			       BT_GATT_PERM_NONE, NULL, NULL, NULL),
	BT_GATT_CCC(htmc_ccc_cfg_changed,
		    BT_GATT_PERM_READ | BT_GATT_PERM_WRITE),
	/* more optional Characteristics */
);

void hts_init(void)
{
	temp_dev = device_get_binding("TEMP_0");

	if (!temp_dev) {
		printk("error: no temp device\n");
		return;
	}

	printk("temp device is %p, name is %s\n", temp_dev,
	       temp_dev->name);
}

void hts_indicate(void)
{
	/* Temperature measurements simulation */
	struct sensor_value temp_value;

	if (simulate_htm) {
		static uint8_t htm[5];
		static double temperature = 20U;
		uint32_t mantissa;
		uint8_t exponent;
		int r;

		if (indicating) {
			return;
		}

		if (!temp_dev) {
			temperature++;
			if (temperature == 30U) {
				temperature = 20U;
			}

			goto gatt_indicate;
		}

		r = sensor_sample_fetch(temp_dev);
		if (r) {
			printk("sensor_sample_fetch failed return: %d\n", r);
		}

		r = sensor_channel_get(temp_dev, SENSOR_CHAN_DIE_TEMP,
				       &temp_value);
		if (r) {
			printk("sensor_channel_get failed return: %d\n", r);
		}

		temperature = sensor_value_to_double(&temp_value);

gatt_indicate:
		printf("temperature is %gC\n", temperature);

		mantissa = (uint32_t)(temperature * 100);
		exponent = (uint8_t)-2;

		htm[0] = 0; /* temperature in celcius */
		sys_put_le24(mantissa, (uint8_t *)&htm[1]);
		htm[4] = exponent;

		ind_params.attr = &hts_svc.attrs[2];
		ind_params.func = indicate_cb;
		ind_params.destroy = indicate_destroy;
		ind_params.data = &htm;
		ind_params.len = sizeof(htm);

		if (bt_gatt_indicate(NULL, &ind_params) == 0) {
			indicating = 1U;
		}
	}
}
```

## src/hts.h
```c
/** @file
 *  @brief HTS Service sample
 */

/*
 * Copyright (c) 2019 Aaron Tsui <aaron.tsui@outlook.com>
 *
 * SPDX-License-Identifier: Apache-2.0
 */

#ifdef __cplusplus
extern "C" {
#endif

void hts_init(void);
void hts_indicate(void);

#ifdef __cplusplus
}
#endif
```

## src/maxik.cpp
```c
#include <zephyr.h>
#include "Arduino.h"
#include "maxik.h"
#include "MAX31856.h"

static constexpr int SDI = 13;
static constexpr int SDO = 15;
static constexpr int CS = 17;
static constexpr int SCK = 20;

static constexpr int CR0_INIT = (CR0_ONE_SHOT + CR0_OPEN_CIRCUIT_FAULT_TYPE_K + CR0_NOISE_FILTER_50HZ + CR0_FAULT_CLEAR + CR0_FAULT_INTERRUPT_MODE);
static constexpr int CR1_16X = (CR1_AVERAGE_16_SAMPLES + CR1_THERMOCOUPLE_TYPE_K);
static constexpr int CR1_1X = (CR1_AVERAGE_1_SAMPLES + CR1_THERMOCOUPLE_TYPE_K);
static constexpr int MASK_INIT = (~(MASK_VOLTAGE_UNDER_OVER_FAULT + MASK_THERMOCOUPLE_OPEN_FAULT));

static MAX31856 sensor_;

void maxik_init()
{
    sensor_.init(SDI, SDO, CS, SCK);
    sensor_.writeRegister(REGISTER_MASK, MASK_INIT);
    sensor_.writeRegister(REGISTER_CR1, CR1_16X);
}

float maxik_read_temp()
{
    sensor_.writeRegister(REGISTER_CR0, CR0_INIT);
    k_sleep(K_MSEC(1000));
    float t = sensor_.readThermocouple(CELSIUS);

    return t;
}
```

## src/maxik.h
```c
#ifndef F7F0F49F_0EF3_4087_99BC_312DE8E6A413
#define F7F0F49F_0EF3_4087_99BC_312DE8E6A413

#ifdef __cplusplus
extern "C"
{
#endif

    void maxik_init();
    float maxik_read_temp();

#ifdef __cplusplus
}
#endif

#endif /* F7F0F49F_0EF3_4087_99BC_312DE8E6A413 */
```

## src/thermo.c
```c
#include <sys/byteorder.h>
#include <bluetooth/bluetooth.h>
#include <bluetooth/conn.h>
#include <bluetooth/gatt.h>
#include <bluetooth/uuid.h>
#include <sys/printk.h>

#include "thermo.h"
#include "maxik.h"

static float temperature = (0.0F / 0.0F);
static uint8_t payload[4] = {0};
static bool notif_enabled = false;

BT_GATT_SERVICE_DEFINE(thermo_svc,
                       BT_GATT_PRIMARY_SERVICE(BT_UUID_ESS),
                       BT_GATT_CHARACTERISTIC(BT_UUID_TEMPERATURE,
                                              BT_GATT_CHRC_NOTIFY,
                                              BT_GATT_PERM_NONE, NULL, NULL,
                                              NULL),
                       BT_GATT_CCC(ccc_cfg_changed,
                                   BT_GATT_PERM_WRITE), );

void ccc_cfg_changed(const struct bt_gatt_attr *attr,
                     uint16_t value)
{
    ARG_UNUSED(attr);

    notif_enabled = (value == BT_GATT_CCC_NOTIFY);

    printk("Temperature Notifications %s\n", notif_enabled ? "enabled" : "disabled");
}

void update_temperature()
{
    // blocking, takes 1 sec
    temperature = maxik_read_temp();
    printk("Updating temp %f\n", temperature);
}

bool check_temperature()
{
    if (!notif_enabled)
    {
        return false;
    }

    update_temperature();

    sys_put_le32((uint32_t)(temperature * 100.0f), (uint8_t *)&payload[0]);

    bt_gatt_notify(NULL, &thermo_svc.attrs[1], &payload, sizeof(payload));

    return true;
}
```

## src/thermo.h
```c
#ifndef BEEC138E_ECB0_424C_A0A7_9A4A4982DF57
#define BEEC138E_ECB0_424C_A0A7_9A4A4982DF57

#ifdef __cplusplus
extern "C"
{
#endif

    ssize_t read_temperature(struct bt_conn *conn,
                             const struct bt_gatt_attr *attr, void *buf,
                             uint16_t len, uint16_t offset);

    void ccc_cfg_changed(const struct bt_gatt_attr *attr,
                         uint16_t value);

    void update_temperature();

    bool check_temperature();

#ifdef __cplusplus
}
#endif

#endif /* BEEC138E_ECB0_424C_A0A7_9A4A4982DF57 */
```
